## config/boards/shields/klor_wired/Kconfig.shield
```kconfig
config SHIELD_KLOR_WIRED_LEFT
    def_bool $(shields_list_contains,klor_wired_left)

config SHIELD_KLOR_WIRED_RIGHT
    def_bool $(shields_list_contains,klor_wired_right)
```

## config/west.yml
```yaml
manifest:
  remotes:
    - name: zmkfirmware
      url-base: https://github.com/zmkfirmware
    - name: refil
      url-base: https://github.com/refil
  projects:
    - name: zmk
      remote: zmkfirmware
      revision: main
      import: app/west.yml
    - name: zmk-adv
      repo-path: zmk
      remote: refil
      revision: adv360-z3.5
      import: app/west.yml
  self:
    path: config
```
